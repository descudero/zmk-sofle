## boards/arm/eyelash_sofle_right/board.yml
```yaml
board:
  name: eyelash_sofle_right
  full_name: Eyelash Sofle Right
  vendor: eyelashperipherals
  socs:
    - name: nrf52840
      variants:
        - name: zmk
```
